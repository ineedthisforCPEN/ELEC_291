// This program imitates the look of an oscilloscope and displays the voltage generated by the function generator
// References taken from:
// https://processing.org/examples/button.html
// http://www.instructables.com/id/Arduino-Improved-Poor-Mans-Oscilloscope/

// * ------------------ HOT KEYS ------------------

final char Z_IN       = 'c'; // Horizontal zoom in
final char Z_OUT      = 'z'; //                 out
final char Y_OFFSET   = 'y'; // Offset for the y-axis
final char Y_DOWN     = 'x';  // moves the graph down

// * --------------- STARTING STATE ---------------
float zoom    = 10.0;
float scale   = 3.0;
float horizontal = 13; 
int com_port  = 0;   // Index number in Serial.list
// * ----------------------------------------------


// Global vars
import processing.serial.*;
Serial port;                    // Create object from Serial class
int val;                        // Data received from the serial port
//long valTime;                 // Time data was received
int[] values;                   // An array that stores all the values (voltages) received from the Serial port
//long[] times;
float voltage;                  // Variable for the most recent voltage reading
//float measTime = 0;
//int   timeMode = 0;
//int[] timeBars = {0, 0};
PFont font;

// *---- Background images to be use
PImage bg;              // 1st background image 
PImage bg2;             // 2nd background image
boolean pause;
//--------------------------------------------

// *---- Variables for the push button
int buttonX, buttonY;                // The x and y position of the button
int buttonSize = 15;                 // Diameter of the button
color buttonColor, baseColor;        // Set the colour of the button
color buttonHighlight;               // Set the colour of the button when clicked
//color currentColor;                  // Variable to keep track of the current colour state of the button
boolean circleOver = false;          // Boolean to check whether the button has been pressed
boolean second_bg = false;          // A background boolean that keeps track of which background is being displayed
//int count = 0;

// Setup for Processing
void setup() {
  
  // Set the size of the display window
  size(1280, 480);
  
  // Create a new serial port object
  port = new Serial(this, Serial.list()[com_port], 9600);    // Com port specified here
  
  values = new int[width];                                   // Initialize array 
  //times = new long[width];
  //timeBars[0] = width/3;
  //timeBars[1] = 2*width/3;
  pause = false;
  smooth();                                                  // Set anti-aliase for the graph lines
  font = createFont("Arial", 18, true);                      // Create a new Arial size 18 font
  
  // *----- Load an image for the background  (picture of an oscilloscope)
  bg = loadImage("oscilloscope_2.png");
  bg2 = loadImage("oscilloscope_3.png");
  
  // *----- Initialize variables used for the push button
  buttonColor = color(255);
  buttonHighlight = color(204);
  baseColor = color(102);
  //currentColor = baseColor;
  buttonX = 1000;                                            // Set the x-position of the button
  buttonY = 430;                                             // Set the y-position of the button
  ellipseMode(CENTER);          
}

// Read value from serial stream
int getValue() {
  int value = -1;
  while (port.available () >= 3) {
    if (port.read() == 0xff) {
      value = (port.read() << 8) | (port.read());
    }
  }
  return value;
}

// Get a y-value for the datapoint, varies based on axis settings
int getY(int val) {
  
  // the "horizontal" variable adjusts the positioning of the graph along the y-axis
  // The graph is originally set along the origin in start-up
  return (int)(height/2 -(val+horizontal)*scale / 1023.0f * (height - 1));
}

// Push the values in the data array
void pushValue(int value) {
  for (int i=0; i<width-1; i++)
    values[i] = values[i+1];
  values[width-1] = value;
}

//// Push the timestamps in the time array
//void pushTime(long time) {
//  for (int i=0; i<width-1; i++)
//    times[i] = times[i+1];
//  times[width-1] = time;
//}

// Draw waveform
void drawLines() {
  
  // *------ Change the colour of the text and graph line based on the current background
  if(!second_bg){
    stroke(0,255,255);
    fill(255);
  } if(second_bg){
    stroke(41,4,251);
    fill(0);
  }
  
  
  // Variables for the x and y plots
  int x0 = 0, x1 = 0, y0 = 0, y1 = 0;
  
  //stroke(255,255,0);
  
  // Plot the x-y points 
  for (int i=0; i<width; i++) {
    x1 = round(width - ((width-i) * zoom));
    y1 = getY(values[i]);
    if(i > 1)
      line(x0, y0, x1, y1);
    x0 = x1;
    y0 = y1;
  }
  
  //*------ Text for displaying information on the GUI
    String volts = "Current voltage value:";
    textSize(19);
    text(volts,100,400);
    
    String buttonCommand = "Press this button to change the background";
    textSize(15);
    text(buttonCommand, 935, 460);
    
    String cKey = "c key zooms in           x key moves the grah down";
    text(cKey, 5, 440);
    
    String zKey = "z key zooms out         y key moves the graph up";
    text(zKey, 5, 460);
    
    textSize(30);
    String elec = "BENCH 6B";
    text(elec, width/2 - 60, 50);
}

// Truncate a floating point number
float truncate(float x, int digits) {
  float temp = pow(10.0, digits);
  return round( x * temp ) / temp;
}

// When a key is released...
void keyReleased() {
  println(key+": "+(int)key);
  switch (key) {
  case Z_IN:                                                 // Zoom horizontal
    zoom *= 2.0f;
    if ( (int) (width / zoom) <= 1 )
      zoom /= 2.0f;
    break;
  case Z_OUT:                                                // Zoom horizontal
    zoom /= 2.0f;
    if (zoom < 1.0f)
      zoom *= 2.0f;
    break;
  case Y_OFFSET:                                             // Move the graph up
    horizontal += 5;
    if(horizontal > (height/2 + 13))
      horizontal -= 5;
      break;
  case Y_DOWN:
    horizontal -=5;
    if(horizontal > height)
      horizontal +=5;
      break;
  }
}


// Primary drawing function
void draw()
{
  if(!second_bg)
  background(bg);
  else if(second_bg)
  background(bg2);
  // Get current voltage, time of reading
  val = getValue();
  //valTime = System.nanoTime();
  
  // If not paused
  if (!pause && val != -1) {
    // Push value/time onto array
    pushValue(val);
    //pushTime(valTime);
    // Print the current voltage reading
    textFont(font, 16);
    fill(204, 102, 0);
    // The conversion 5.0 * val / 1023 is done because the analog values 0 - 1023 correspond to voltage values between 0 - 5
    voltage = truncate(5.0*val / 1023, 1);
    displayVoltage(voltage);
  }
  drawLines();
  update(mouseX, mouseY);

 // *----- Draw the push button on the GUI
  if (circleOver) {
    fill(buttonHighlight);
  } else {
    fill(buttonColor);
  }
  stroke(0);
  ellipse(buttonX, buttonY, buttonSize, buttonSize);
}

// Function that displays the current voltage on the GUI
void displayVoltage(float voltage){
    String s = "Current voltage value:"+voltage; 
    textSize(19);
    text(s,100,400);
}

// Updates the current state of the button 
void update(int x, int y) {
  if ( buttonClick(buttonX, buttonY, buttonSize) ) {
    circleOver = true;

  } else {
    circleOver = false;
  }
}

// Updates the current status of the background when the push button is clicked
void mousePressed() {
  if (circleOver && !second_bg) {
    second_bg = true;
  }
  else if(circleOver && second_bg){
    second_bg = false;
  }
}

// This function checks to see whether or not the button is clicked
boolean buttonClick(int x, int y, int diameter) {
  float disX = x - mouseX;
  float disY = y - mouseY;
  if (sqrt(sq(disX) + sq(disY)) < diameter/2 ) {
    return true;
  } else {
    return false;
  }
}